## meta-mncos/conf/distro/include/default-features.conf
```bitbake
INIT_MANAGER_MNCUX_DEFAULT = "systemd"
INIT_MANAGER_MNCUX_DEFAULT:zub = ${INIT_MANAGER_MNCUX_DEFAULT}
INIT_MANAGER_MNCUX_DEFAULT:old = "sysvinit"

INIT_MANAGER_DEFAULT ?= "${INIT_MANAGER_MNCUX_DEFAULT}"

# The user can override INIT_MANAGER by setting INIT_MANAGER_DEFAULT
INIT_MANAGER = "${INIT_MANAGER_DEFAULT}"


#OpenAMP?
```

## meta-mncos/conf/distro/mncux.conf
```bitbake
require conf/distro/poky.conf

MAINTAINER = "Monutchee lesterlo <no@no>"

unset INIT_MANAGER

require conf/distro/include/default-features.conf

# General parameters
BB_DANGLINGAPPENDS_WARNONLY = "1"
IMAGE_FSTYPES:append=" wic.xz"


# Distro parameters
DISTRO = "mncux"
DISTRO_NAME = "MNCux"
DISTRO_VERSION = "0.0.1"

# SDK parameters
SDK_VENDOR = "-mnc"
SDK_VERSION := "0.0.1"


TARGET_VENDOR = "-mnc"


# Default user login
INHERIT += "extrausers"
PASSWD = "\$6\$JhxKZIUcLbr/ojXz\$yDoAFWlulny4bQ9TTghkPzccartwUoN0mU2qZxZ9Ez0fD8/vtkGK1qNFx4/oPHN/POTaDk0EYqZJjvLQYafYY."
EXTRA_USERS_PARAMS = "\
    usermod -p '${PASSWD}' root; \
    "
```

## meta-zuboard/conf/machine/zub-zynqmp.conf
```bitbake
require conf/machine/zynqmp-cg-generic.conf


HDF_BASE = "file://"
HDF_PATH = "<Path-to-xsa-file>"
```

## meta-zuboard/conf/machine/zub.conf
```bitbake
require conf/machine/zynqmp-cg-generic.conf

DISTRO_FEATURES:append = " openamp"
IMAGE_INSTALL:append = " open-amp libmetal open-amp-device-tree"

# Should be handle in build/conf/local.conf
# HDF_BASE = "file://"
# HDF_PATH = "<Path-to-xsa-file>"

# Core R5 app
#FW_NAME ?= ""
#FW_PATH ?= ""
```
